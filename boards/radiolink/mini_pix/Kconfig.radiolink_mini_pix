## boards/radiolink/mini_pix/Kconfig.radiolink_mini_pix
```kconfig
# Copyright (c) 2024 Pavlo Yadvychuk
# SPDX-License-Identifier: Apache-2.0

config BOARD_RADIOLINK_MINI_PIX
	select SOC_STM32F405XX
```

## boards/radiolink/mini_pix/board.yml
```yaml
board:
  name: radiolink_mini_pix
  full_name: Radiolink Mini Pix
  vendor: radiolink
  socs:
    - name: stm32f405xx
```

## boards/radiolink/mini_pix/radiolink_mini_pix_defconfig
```kconfig
# SPDX-License-Identifier: Apache-2.0

# Enable MPU
CONFIG_ARM_MPU=y

# Enable HW stack protection
CONFIG_HW_STACK_PROTECTION=y

# Clock configuration
CONFIG_CLOCK_STM32_HSE_CLOCK=24000000
```
